#include <Wire.h>
#include <Adafruit_GFX.h>
#include <Adafruit_SSD1306.h>


#define OLED_RESET     -1//unused
#define ADDRESS 0x3C  // most common I2C address, if it doesn't work try 0x3D or just run a script to find it, chatgpt can make 1 for  you
Adafruit_SSD1306 display(128, 64, &Wire, OLED_RESET);

int buttonPin = 7;
int togglePin = 10;
bool isDice = true;


//thank you
const unsigned char epd_bitmap_New_Piskel [] PROGMEM = {
	0x00, 0x00, 0x00, 0x00, 0x00, 0x00, 0x00, 0x00, 0x00, 0x00, 0x00, 0x00, 0x00, 0x00, 0x00, 0x00, 
	0x00, 0x00, 0x00, 0x00, 0x00, 0x00, 0x00, 0x00, 0x00, 0x00, 0x00, 0x00, 0x00, 0x00, 0x00, 0x00, 
	0x00, 0x00, 0x00, 0x00, 0x00, 0x00, 0x00, 0x00, 0x00, 0x00, 0x40, 0x00, 0x00, 0x00, 0x00, 0x00, 
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	0x00, 0x00, 0x00, 0x00, 0x00, 0x00, 0x00, 0x00, 0x00, 0x00, 0x00, 0x00, 0x00, 0x00, 0x00, 0x00
};

// Array of all bitmaps for convenience. (Total bytes used to store images in PROGMEM = 1040)
const int epd_bitmap_allArray_LEN = 1;
const unsigned char* epd_bitmap_allArray[1] = {
	epd_bitmap_New_Piskel
};

void setup() {
  Serial.begin(9600);
  if (!display.begin(SSD1306_SWITCHCAPVCC, ADDRESS)) {
    Serial.println(F("SSD1306 allocation failed"));
    for (;;); //loop forever
  }
  
  display.clearDisplay();
  display.drawBitmap(0, 0, epd_bitmap_New_Piskel, 128, 64, SSD1306_WHITE);
  display.display();

  delay(2000);
  display.clearDisplay(); //gets rid of the adafruit splash
  display.setTextColor(SSD1306_WHITE);
  display.setTextSize(2);//maximum of 10 characters per row, maximum of 4 rows
  display.setCursor(0, 0); //moves the cursor to the top left
  display.println("Random Num");
  display.display();//actually puts the stuff onto the screen.


  pinMode(buttonPin, INPUT_PULLUP);//tells the arduino that buttonPin is an input, and pullup just means we don't need an extra resistor.
  pinMode(togglePin, INPUT_PULLUP);
}

void loop() {
  if(digitalRead(togglePin)==LOW) {
    isDice = !isDice;
    delay(500);
  }
  
  if(digitalRead(buttonPin)==LOW) {


    //just clears the display and adds the random number text back cause I can't be asked to figure out a way to make it only clear the random number
    display.clearDisplay();
    display.setTextColor(SSD1306_WHITE);
    display.setTextSize(2);
    display.setCursor(0, 0); 
    display.println("Random Num");
    display.display();

    if(isDice){
      int num = random(1, 7); //random number from 1-6, maximum value is exclusive
      display.setTextSize(2);
        if(num==1) {
          display.setCursor(46, 36);
          display.println(F(" o "));
          display.display();
        }else if(num==2) {
          display.setCursor(46, 24);
          display.println(F("o "));
          display.setCursor(46, 48);
          display.println(F("  o"));
          display.display();
        }else if(num==3) {
          display.setCursor(46, 24);
          display.println(F("o "));
          display.setCursor(46, 36);
          display.println(F(" o "));
          display.setCursor(46, 48);
          display.println(F("  o"));
          display.display();
        }else if(num==4) {
          display.setCursor(46, 24);
          display.println(F("o o"));
          display.setCursor(46, 48);
          display.println(F("o o"));
          display.display();
        }else if(num==5) {
          display.setCursor(46, 24);
          display.println(F("o o"));
          display.setCursor(46, 36);
          display.println(F(" o "));
          display.setCursor(46, 48);
          display.println(F("o o"));
          display.display();
        }else if(num==6) {
          display.setCursor(46, 24);
          display.println(F("o o"));
          display.setCursor(46, 36);
          display.println(F("o o"));
          display.setCursor(46, 48);
          display.println(F("o o"));
          display.display();
        }else {
          display.setCursor(0, 32);
          display.setTextSize(1);
          display.println("something broke");
        }
    }


    if(!isDice) {
      display.setTextSize(4);
      int num = random(1, 11);//random number 1-10
      if(num!=10) {
        display.setCursor(54, 28);//different spot since 10 is a 2 digit number while 1-9 are all 1 digit
      }else {
        display.setCursor(44, 28);
      }
      display.println(num);
      display.display();
    }
  }
  
}
